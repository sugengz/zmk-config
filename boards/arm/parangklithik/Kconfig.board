## boards/arm/parangklithik/Kconfig.board
```kconfig
config BOARD_PARANGKLITHIK
    bool "parangklith"
    depends on SOC_NRF52840_QIAA
```

## boards/shields/parangklithik/Kconfig.defconfig
```kconfig
if SHIELD_PARANGKLITHIK

config ZMK_KEYBOARD_NAME
    default "parangklithik"

endif # SHIELD_PARANGKLITHIK
```

## boards/shields/parangklithik/Kconfig.shield
```kconfig
config SHIELD_PARANGKLITHIK_LEFT
    def_bool $(shields_list_contains,parangklithik_left)
  
config SHIELD_PARANGKLITHIK_RIGHT
    def_bool $(shields_list_contains,parangklithik_right)
  
```

## config/west.yml
```yaml
manifest:
  defaults:
    revision: v0.3
  remotes:
    - name: zmkfirmware
      url-base: https://github.com/zmkfirmware
    - name: parangklithik
      url-base: https://github.com/sugengz
    # Additional modules containing boards/shields/custom code can be listed here as well
    # See https://docs.zephyrproject.org/3.2.0/develop/west/manifest.html#projects
  projects:
    - name: zmk
      remote: zmkfirmware
      import: app/west.yml
    - name: parangklithik
      remote: parangklithik
      import: app/west.yml
  self:
    path: config
```
